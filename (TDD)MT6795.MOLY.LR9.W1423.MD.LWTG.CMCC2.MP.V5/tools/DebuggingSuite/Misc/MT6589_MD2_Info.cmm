;;
;; MT6589_MD2_Info.cmm
;;

;; Modem paths and selection for MD2 (ARM9)
GLOBAL &OPT_MD2_ELF_PATH
&OPT_MD2_ELF_PATH="[CMMAUTOGEN_ELFPath]"

GLOBAL &OPT_MD2_BIN_PATH
&OPT_MD2_BIN_PATH="[CMMAUTOGEN_BINPath]"

GLOBAL &OPT_MD2_SRC_PATH
&OPT_MD2_SRC_PATH="[CMMAUTOGEN_SrcPath]"

&OPT_MD_SEL=[CMMAUTOGEN_ChipSelect]
