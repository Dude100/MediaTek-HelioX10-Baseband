;;
;; MT6595_MD_Info.cmm
;;

;; Modem paths and selection for MD (CR4)
GLOBAL &OPT_MD_ELF_PATH
&OPT_MD_ELF_PATH="[CMMAUTOGEN_ELFPath]"

GLOBAL &OPT_MD_BIN_PATH
&OPT_MD_BIN_PATH="[CMMAUTOGEN_BINPath]"

GLOBAL &OPT_MD_SRC_PATH
&OPT_MD_SRC_PATH="[CMMAUTOGEN_SrcPath]"

;; Modem DSP path
GLOBAL &OPT_DSP_BIN_PATH
&OPT_DSP_BIN_PATH="[CMMAUTOGEN_DSPBINPath]"


;; For Multi-Core Debugging

GLOBAL &OPT_MD_ELF_AUTO_LOAD
&OPT_MD_ELF_AUTO_LOAD=1
;   1: auto load elf file specified in &OPT_ELF_PATH
;   0: manually select elf file
