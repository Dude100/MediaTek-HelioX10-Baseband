;;
;; MT6589_MD1_Info.cmm
;;

;; Modem paths and selection for MD1 (CR4)
GLOBAL &OPT_MD1_ELF_PATH
&OPT_MD1_ELF_PATH="[CMMAUTOGEN_ELFPath]"

GLOBAL &OPT_MD1_BIN_PATH
&OPT_MD1_BIN_PATH="[CMMAUTOGEN_BINPath]"

GLOBAL &OPT_MD1_SRC_PATH
&OPT_MD1_SRC_PATH="[CMMAUTOGEN_SrcPath]"

&OPT_MD_SEL=[CMMAUTOGEN_ChipSelect]
