ENTRY &CMMName &Function

DODECRYPT "SystemService" &CMMName.cmm &Function
//DO &CMMName.cmm &Function