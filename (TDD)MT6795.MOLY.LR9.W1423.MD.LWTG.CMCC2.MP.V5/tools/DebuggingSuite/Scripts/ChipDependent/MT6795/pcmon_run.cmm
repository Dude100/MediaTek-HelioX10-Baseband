Do BuildInfo.cmm

&MT6290_CR4ID=0x411FC144
&MT6290_CA7ID=0x410FC072

&CPU=DATA.LONG(C15:0)

;discontinuous address = 0 in BASE setting
&DISCONTINUOUS_BASE=0x00000000
&DISCONTINUOUS_2=0x00000000
&DISCONTINUOUS_4=0x00000100
&DISCONTINUOUS_6=0x00000200
&DISCONTINUOUS_8=0x00000300
&DISCONTINUOUS_16=0x00000700
&DISCONTINUOUS_32=0x00000F00
&DISCONTINUOUS_64=0x00001F00
&DISCONTINUOUS_128=0x00003F00
&DISCONTINUOUS_256=0x00007F00

IF &CPU==&MT6290_CR4ID
(
    ;PCMON
    ;Clear BUM Stop
    d.s (&BASE_ADDR_MDPCMON+4) %long 0x0
    ;reenable PCM
    d.s (&BASE_ADDR_MDPCMON+4) %long 0x1
    ;enable ETMPWRUP, mode:recording 16 pair discontinuous PCs
	;discontinuous 2
	;d.s (&BASE_ADDR_MDPCMON+0) %long 0x100001
    d.s (&BASE_ADDR_MDPCMON+0) %long (&DISCONTINUOUS_2|0x100001)
    ;discontinuous 4
    ;d.s (&BASE_ADDR_MDPCMON+0) %long 0x100101
    ;d.s (&BASE_ADDR_MDPCMON+0) %long (&DISCONTINUOUS_4|0x100001)
    
    go
    
    wait !run()
    
    ; stop PCMON
    d.s (&BASE_ADDR_MDPCMON+4) %long 0x80000000
	d &BASE_ADDR_MDPCMON
    ENDDO
)

go
