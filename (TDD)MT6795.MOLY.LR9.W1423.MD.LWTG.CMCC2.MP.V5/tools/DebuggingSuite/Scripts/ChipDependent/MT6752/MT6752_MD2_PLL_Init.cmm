;;;;;;;;;; register base
&PLL_MIXEDSYS_base=0x80120000
&CONFIG_base=0x80000000
&MEM_CLASS="pm"

&PLL_PLL_CON1=(&PLL_MIXEDSYS_base+0x044)
&PLL_PLL_CON2=(&PLL_MIXEDSYS_base+0x048)
&PLL_PLL_CON3=(&PLL_MIXEDSYS_base+0x04C)
&PLL_LTEMDPLL_TEST=(&PLL_MIXEDSYS_base+0x05C)
&PLL_CLKSW_CKSEL0=(&PLL_MIXEDSYS_base+0x060)
&PLL_CLKSW_CKSEL1=(&PLL_MIXEDSYS_base+0x064)
&PLL_CLKSW_CKSEL2=(&PLL_MIXEDSYS_base+0x068)
&PLL_CLKSW_CKSEL3=(&PLL_MIXEDSYS_base+0x06C)
&PLL_CLKSW_FDIV0=(&PLL_MIXEDSYS_base+0x070)
&PLL_CLKSW_FDIV1=(&PLL_MIXEDSYS_base+0x074)
&PLL_CLKSW_FDIV2=(&PLL_MIXEDSYS_base+0x078)
&PLL_CLKSW_FDIV3=(&PLL_MIXEDSYS_base+0x07C)
&PLL_CLKSW_FDIV4=(&PLL_MIXEDSYS_base+0x080)
&PLL_CLKSW_FDIV5=(&PLL_MIXEDSYS_base+0x084)
&PLL_CLKSW_FDIV6=(&PLL_MIXEDSYS_base+0x088)
&PLL_CLKSW_FDIV7=(&PLL_MIXEDSYS_base+0x08C)
&PLL_CLKSW_CONN_CON0=(&PLL_MIXEDSYS_base+0x090)
&PLL_DFS_CON7=(&PLL_MIXEDSYS_base+0x0AC)
&PLL_DFS_CON8=(&PLL_MIXEDSYS_base+0x0B0)
&PLL_DFS_CON9=(&PLL_MIXEDSYS_base+0x0B4)
&PLL_MDPLL_CON0=(&PLL_MIXEDSYS_base+0x100)
&PLL_MDPLL_CON1=(&PLL_MIXEDSYS_base+0x104)
&PLL_MDPLL_CON2=(&PLL_MIXEDSYS_base+0x108)
&PLL_MDPLL_CON3=(&PLL_MIXEDSYS_base+0x10C)
&PLL_MDPLL_CON4=(&PLL_MIXEDSYS_base+0x110)
&PLL_MCUPLL_CON0=(&PLL_MIXEDSYS_base+0x140)
&PLL_MCUPLL_CON1=(&PLL_MIXEDSYS_base+0x144)
&PLL_MCUPLL_CON2=(&PLL_MIXEDSYS_base+0x148)
&PLL_MCUPLL_CON3=(&PLL_MIXEDSYS_base+0x14C)
&PLL_WPLL_CON0=(&PLL_MIXEDSYS_base+0x1C0)
&PLL_WPLL_CON1=(&PLL_MIXEDSYS_base+0x1C4)
&PLL_WPLL_CON2=(&PLL_MIXEDSYS_base+0x1C8)
&PLL_WPLL_CON3=(&PLL_MIXEDSYS_base+0x1CC)
&PLL_WHPLL_CON0=(&PLL_MIXEDSYS_base+0x200)
&PLL_WHPLL_CON1=(&PLL_MIXEDSYS_base+0x204)
&PLL_WHPLL_CON2=(&PLL_MIXEDSYS_base+0x208)
&PLL_WHPLL_CON3=(&PLL_MIXEDSYS_base+0x20C)
&PLL_WHPLL_CON4=(&PLL_MIXEDSYS_base+0x210)
&PLL_ABIST_FQMTR_CON0=(&PLL_MIXEDSYS_base+0x400)
&PLL_ABIST_FQMTR_CON1=(&PLL_MIXEDSYS_base+0x404)
&PLL_ABIST_FQMTR_CON2=(&PLL_MIXEDSYS_base+0x408)
&PLL_ABIST_FQMTR_DATA=(&PLL_MIXEDSYS_base+0x40C)
&PLL_FH_CON0=(&PLL_MIXEDSYS_base+0x500)
&PLL_FH_CON1=(&PLL_MIXEDSYS_base+0x504)
&PLL_FH_CON2=(&PLL_MIXEDSYS_base+0x508)
&PLL_FH_CON3=(&PLL_MIXEDSYS_base+0x50C)
&PLL_FH_CON4=(&PLL_MIXEDSYS_base+0x510)
&PLL_FH_CON5=(&PLL_MIXEDSYS_base+0x514)
&PLL_FH_CON6=(&PLL_MIXEDSYS_base+0x518)
&PLL_FH_CON7=(&PLL_MIXEDSYS_base+0x51C)
&PLL_FH_CON8=(&PLL_MIXEDSYS_base+0x520)
&PLL_FH_CON9=(&PLL_MIXEDSYS_base+0x524)
&PLL_FH_CON10=(&PLL_MIXEDSYS_base+0x528)
&PLL_FH_CON11=(&PLL_MIXEDSYS_base+0x52C)
&PLL_FH_CON12=(&PLL_MIXEDSYS_base+0x530)
&PLL_FH_CON13=(&PLL_MIXEDSYS_base+0x534)
&PLL_FH_CON14=(&PLL_MIXEDSYS_base+0x538)
&PLL_FH_CON15=(&PLL_MIXEDSYS_base+0x53C)
&PLL_FH_CON16=(&PLL_MIXEDSYS_base+0x540)
&PLL_FH_CON17=(&PLL_MIXEDSYS_base+0x544)
&PLL_FH_CON18=(&PLL_MIXEDSYS_base+0x548)
&PLL_FH_CON19=(&PLL_MIXEDSYS_base+0x54C)
&PLL_FH_CON20=(&PLL_MIXEDSYS_base+0x550)
&PLL_FH_CON21=(&PLL_MIXEDSYS_base+0x554)
&PLL_FH_CON22=(&PLL_MIXEDSYS_base+0x558)
&PLL_FH_CON23=(&PLL_MIXEDSYS_base+0x55C)
&PLL_FH_CON24=(&PLL_MIXEDSYS_base+0x560)
&PLL_FH_CON25=(&PLL_MIXEDSYS_base+0x564)
&PLL_FH_CON26=(&PLL_MIXEDSYS_base+0x568)
&PLL_FH_CON27=(&PLL_MIXEDSYS_base+0x56C)
&PLL_FH_CON28=(&PLL_MIXEDSYS_base+0x570)
&PLL_FH_CON29=(&PLL_MIXEDSYS_base+0x574)
&PLL_FH_CON30=(&PLL_MIXEDSYS_base+0x578)
&PLL_FH_CON31=(&PLL_MIXEDSYS_base+0x57C)
&PLL_FH_CON32=(&PLL_MIXEDSYS_base+0x580)
&PLL_PLLTD_CON0=(&PLL_MIXEDSYS_base+0x700)
&PLL_PLLTD_CON1=(&PLL_MIXEDSYS_base+0x704)
&PLL_PLLTD_CON2=(&PLL_MIXEDSYS_base+0x708)
&PLL_PLLTD_CON3=(&PLL_MIXEDSYS_base+0x70C)
&PLL_PLLTD_CON4=(&PLL_MIXEDSYS_base+0x710)
&PLL_PLLTD_CON5=(&PLL_MIXEDSYS_base+0x714)
&PLL_PLLTD_CON6=(&PLL_MIXEDSYS_base+0x718)
&PLL_PLLTD_CON7=(&PLL_MIXEDSYS_base+0x71C)
&PLL_MD_GLOBAL_CON1=(&CONFIG_base+0x45C)

;;;;;;;;;; options
&WHPLL_TDD_MODE=0
&MCUPLL_ON=1
&WHPLL_TDD_MODE=0
&PLL_DIV=0
&SIM_26M=0
&WHPLL_ON=0

;;;;;;;;;;;;;;;;;;;;;;;;;;;;;;;;;;;;;;;;;;;;;;;;;;;;;;
;; Sequence to enable PLL
;;;;;;;;;;;;;;;;;;;;;;;;;;;;;;;;;;;;;;;;;;;;;;;;;;;;;;

PRINT "wait  1s  for CLKSQ and BIAS_LPF enable settle, but no need to wait when boot up"
WAIT 1s

d.s &PLL_DFS_CON7        %word %le 0x0033
d.s &PLL_PLL_CON3        %word %le 0x8000
d.s &PLL_PLL_CON3        %word %le 0x0000
d.s &PLL_PLL_CON2        %word %le 0x0000
d.s &PLL_PLLTD_CON0      %word %le 0x0010
d.s &PLL_MCUPLL_CON0     %word %le (data.word(&MEM_CLASS:&PLL_MCUPLL_CON0)&0xFFEF)
d.s &PLL_MCUPLL_CON0     %word %le (data.word(&MEM_CLASS:&PLL_MCUPLL_CON0)|0x8000)
PRINT "WAIT 2ms"
WAIT 2ms
d.s &PLL_PLLTD_CON0      %word %le 0x0000
PRINT "WAIT 2ms"
WAIT 2ms
;;; d.s &PLL_FH_CON5         %word %le 0x0076
;;; PRINT "WAIT 2ms"
;;; WAIT 2ms
;;; d.s &PLL_FH_CON4         %word %le 0xA455
PRINT "WAIT 2ms"
WAIT 2ms
PRINT "WAIT 2ms"
WAIT 2ms
d.s &PLL_MDPLL_CON0      %word %le (data.word(&MEM_CLASS:&PLL_MDPLL_CON0)|0x8000)
PRINT "WAIT 2ms"
WAIT 2ms
d.s &PLL_MDPLL_CON0      %word %le (data.word(&MEM_CLASS:&PLL_MDPLL_CON0)&0x7FFF)
d.s &PLL_MDPLL_CON4      %word %le (data.word(&MEM_CLASS:&PLL_MDPLL_CON0)&0xFFFE)
d.s &PLL_MDPLL_CON0      %word %le (data.word(&MEM_CLASS:&PLL_MDPLL_CON0)|0x8000)
PRINT "WAIT 2ms"
WAIT 2ms
;;; d.s &PLL_CLKSW_FDIV0     %word %le 0x0420
;;; d.s &PLL_CLKSW_FDIV2     %word %le 0x0020
;;; d.s &PLL_CLKSW_FDIV6     %word %le (data.word(&MEM_CLASS:&PLL_CLKSW_FDIV6)|0x0017)
;;; d.s &PLL_CLKSW_FDIV6     %word %le (data.word(&MEM_CLASS:&PLL_CLKSW_FDIV6)|0x05C0)
;;; d.s &PLL_CLKSW_FDIV6     %word %le (data.word(&MEM_CLASS:&PLL_CLKSW_FDIV6)&0xFA3F)
d.s &PLL_CLKSW_FDIV7     %word %le 0xC100
d.s &PLL_MD_GLOBAL_CON1  %long %le (data.long(&MEM_CLASS:&PLL_MD_GLOBAL_CON1)|0x20000000)
d.s &PLL_CLKSW_CKSEL3    %word %le 0x0113
d.s &PLL_CLKSW_CKSEL0    %word %le 0x2020
d.s &PLL_CLKSW_CKSEL1    %word %le 0x2000
d.s &PLL_CLKSW_CKSEL2    %word %le 0x2220
d.s &PLL_CLKSW_CKSEL3    %word %le 0x0113
; d.s &PLL_DFS_CON7        %word %le 0x0000

PRINT "MT6752 MD2 PLL INIT Done"

ENDDO
