;;;;;;;;;;;;;;;;;;;;;;;;;;;;;;;;;;;;;;;;;;;;;;;;;;;;;;;;;;;;;;;;;;;;;;;;;;
;
; File:         MT6595_MultiCore_AP.cmm
;
; Description:  For MT6595 AP reset and go/attach
;
;;;;;;;;;;;;;;;;;;;;;;;;;;;;;;;;;;;;;;;;;;;;;;;;;;;;;;;;;;;;;;;;;;;;;;;;;;

ENTRY &OPT_RESET

&OPT_AP_DEBUG=0 ; set 1 if at ap side

;;-> # Option: Serial Wire or Parallel JTAG
;; 0: Parallel
;; 1: Serial Wire
IF isfileexist(SerialWireJTAG.txt)
(
    &OPT_JTAG=1
)
ELSE
(
    &OPT_JTAG=0
)

; Show CVD information window
WINPOS 0% 0% 50% 50%
AREA
PRINT "== MT6595_MultiCore_AP.cmm =="
PRINT "OPT_RESET = &OPT_RESET"
PRINT "============================="


PRINT "[Step 1] Press enter to continue master..."
ENTER &nop

LOCAL &OPT_JTAG
LOCAL &OPT_AP_NR_CPUS
LOCAL &OPT_AP_COREBASE

&OPT_JTAG=0
&OPT_AP_NR_CPUS=1
&OPT_AP_COREBASE="0x80070000"

; CodeViser setting for Cortex-A7
DO CA7_connect.cmm &OPT_RESET
WAIT 100.ms

; Setting attribute of breakpoints
; Setting HW breakpoint by default
Break.Select Program OnChip
Break.Select Hll OnChip
Break.Select Read OnChip
Break.Select Write OnChip

; Set bit0 for CCCI wait handshake forever
PRINT "Set modem debug mode"
PRINT "[1011A010] <- (0x1)"
Data.Set A:1011A010 %LE %WORD DATA.LONG(A:1011A010)|(0x1)

; Disable DABORT and PABORT breakpoint
tronchip.set dabort off
tronchip.set pabort off
tronchip.set undef  off

; 
; Linux kernel init
;

&KernelPath="../../../../kernel/out"

IF OS.FILE(&KernelPath/vmlinux)
(
    PRINT "loading Linux kernel symbols..."
    Data.LOAD.Elf &KernelPath/vmlinux /gnu /nocode
    WAIT 100.ms
)
ELSE
(
    PRINT "can't find vmlinux"
    IF &OPT_AP_DEBUG==1
    (
        Dialog.file *.elf
        ENTRY &elf
        IF OS.FILE("&elf")
        (
            Data.LOAD.Elf "&elf" /gnu /nocode
            WAIT 100.ms
        )
    )
)

y.spath.reset
y.spath.srd &KernelPath/init
y.spath.srd &KernelPath/mm
y.spath.srd &KernelPath/kernel
y.spath.srd &KernelPath/kernel/irq
y.spath.srd &KernelPath/arch/arm/kernel
y.spath.srd &KernelPath/arch/arm/mm
y.spath.srd &KernelPath/arch/arm/lib
y.spath.srd &KernelPath/lib
y.spath.srd &KernelPath/drivers/serial


; Setup Linx awareness
TASK.CONFIG linux       ; loads Linux awareness (linux.t32)
MENU.ReProgram linux    ; loads Linux menu (linux.men)
HELP.FILTER.Add rtoslinux  ; add linux awareness manual to help filter

menu.reprogram AP_Debug; loads Linux menu (linux.men)

IF "&OPT_RESET"=="RESET"
(
    
    ; Wait AP CCCI load modem
    PRINT "wait 20s until CCCI power on modem..."
    GO
    WAIT 20.s
    BREAK
    WHILE(DATA.LONG(A:1011A010)|(0x1))
    (
        PRINT "Modem image not ready yet, please wait 5 second."
        GO
        WAIT 5.s
        BREAK
    )
)

PRINT "[Step 2]"
PRINT "    Please switch to MD side CVD to continue debugging..."

;DO MT6595_WDT.cmm  disable_ap_wdt
;; Disable WDT
Data.Set c:0x10007000 %le %long 0x22000000

ENDDO
