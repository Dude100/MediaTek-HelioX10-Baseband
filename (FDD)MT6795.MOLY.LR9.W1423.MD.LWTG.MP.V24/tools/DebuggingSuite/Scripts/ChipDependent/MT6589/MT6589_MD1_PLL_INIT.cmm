;// force 26M and PLL on
&PLL_DFS_CON7=DATA.LONG(SD:0x201200AC)
&PLL_DFS_CON7=0x003F
D.S SD:0x201200AC %LE %LONG &PLL_DFS_CON7

;// enable MTCMOS control 
&PLL_PLL_CON3=DATA.LONG(SD:0x2012004C)
&PLL_PLL_CON3=0x8100
D.S SD:0x2012004C %LE %LONG &PLL_PLL_CON3

; /* Wait 1us */
wait 1.ms

;// enable MTCMOS and TOPSM control 
&PLL_PLL_CON3=0x0000
D.S SD:0x2012004C %LE %LONG &PLL_PLL_CON3

// enable TOPSM control 
&PLL_PLL_CON2=DATA.LONG(SD:0x20120048)
&PLL_PLL_CON2=0x0000
D.S SD:0x20120048 %LE %LONG &PLL_PLL_CON2

;// enable delay control 
&PLL_PLLTD_CON0=DATA.LONG(SD:0x20120700)
&PLL_PLLTD_CON0=0x0010
D.S SD:0x20120700 %LE %LONG &PLL_PLLTD_CON0

; /* Wait 3us */
wait 1.ms

;//enable MDPLL and MDPLL2
&PLL_MDPLL_CON0=DATA.LONG(SD:0x20120100)
&PLL_MDPLL_CON0=&PLL_MDPLL_CON0|0x8000
D.S SD:0x20120100 %LE %LONG &PLL_MDPLL_CON0

;//enable MCUPLL and MCUPLL2
&PLL_MCUPLL_CON0=DATA.LONG(SD:0x20120140)
&PLL_MCUPLL_CON0=&PLL_MCUPLL_CON0|0x8000
D.S SD:0x20120140 %LE %LONG &PLL_MCUPLL_CON0

;//enable WPLL
&PLL_WPLL_CON0=DATA.LONG(SD:0x201201C0)
&PLL_WPLL_CON0=&PLL_WPLL_CON0|0x8000
D.S SD:0x201201C0 %LE %LONG &PLL_WPLL_CON0

;//enable WHPLL
&PLL_WHPLL_CON0=DATA.LONG(SD:0x20120200)
&PLL_WHPLL_CON0=&PLL_WHPLL_CON0|0x8000
D.S SD:0x20120200 %LE %LONG &PLL_WHPLL_CON0

; /* Wait 100us */
wait 1.ms

;// enable FH delay control 
&PLL_PLLTD_CON0=DATA.LONG(SD:0x20120700)
&PLL_PLLTD_CON0=0x0000;
D.S SD:0x20120700 %LE %LONG &PLL_PLLTD_CON0

; /* Wait 1us */
wait 1.ms

;//disable AUTOK of MDPLL and MDPLL2
&PLL_MDPLL_CON4=DATA.LONG(SD:0x20120110)
&PLL_MDPLL_CON4=&PLL_MDPLL_CON4&0xFFFE
D.S SD:0x20120110 %LE %LONG &PLL_MDPLL_CON4

;// Sequence to switch to PLL clocks as below:
;//Switch CR4 clock to 481MHz
&PLL_CLKSW_CKSEL0=DATA.LONG(SD:0x20120060)
&PLL_CLKSW_CKSEL0=&PLL_CLKSW_CKSEL0&0x0FFF
&PLL_CLKSW_CKSEL0=&PLL_CLKSW_CKSEL0|0x2000
D.S SD:0x20120060 %LE %LONG &PLL_CLKSW_CKSEL0

// Set ghmdbus_pllck_sel
&PLL_MD_GLOBAL_CON1=DATA.LONG(SD:0x2000045C)
&PLL_MD_GLOBAL_CON1=&PLL_MD_GLOBAL_CON1|0x20000000
&PLL_MD_GLOBAL_CON1=0x21008510
D.S SD:0x2000045C %LE %LONG &PLL_MD_GLOBAL_CON1

;//Switch MD bus clock to MPLL divider 1
&PLL_CLKSW_FDIV0=DATA.LONG(SD:0x20120070)
&PLL_CLKSW_FDIV0=&PLL_CLKSW_FDIV0&0xF0FF
&PLL_CLKSW_FDIV0=&PLL_CLKSW_FDIV0|0x0400
D.S SD:0x20120070 %LE %LONG &PLL_CLKSW_FDIV0

&PLL_CLKSW_FDIV6=DATA.LONG(SD:0x20120088)
&PLL_CLKSW_FDIV6=&PLL_CLKSW_FDIV6|0x0010
D.S SD:0x20120088 %LE %LONG &PLL_CLKSW_FDIV6

&PLL_CLKSW_FDIV6=DATA.LONG(SD:0x20120088)
&PLL_CLKSW_FDIV6=&PLL_CLKSW_FDIV6|0x0400
D.S SD:0x20120088 %LE %LONG &PLL_CLKSW_FDIV6

&PLL_CLKSW_FDIV6=DATA.LONG(SD:0x20120088)
&PLL_CLKSW_FDIV6=&PLL_CLKSW_FDIV6&0xFBFF
D.S SD:0x20120088 %LE %LONG &PLL_CLKSW_FDIV6

&PLL_CLKSW_CKSEL1=DATA.LONG(SD:0x20120064)
&PLL_CLKSW_CKSEL1=&PLL_CLKSW_CKSEL1&0x0FFF
&PLL_CLKSW_CKSEL1=&PLL_CLKSW_CKSEL1|0x2000
D.S SD:0x20120064 %LE %LONG &PLL_CLKSW_CKSEL1


;//Switch DSP clock to 240.5MHz from MCUPLL
&PLL_CLKSW_FDIV0=DATA.LONG(SD:0x20120070)
&PLL_CLKSW_FDIV0=&PLL_CLKSW_FDIV0&0xFF0F
&PLL_CLKSW_FDIV0=&PLL_CLKSW_FDIV0|0x0020
D.S SD:0x20120070 %LE %LONG &PLL_CLKSW_FDIV0
		
&PLL_CLKSW_FDIV6=DATA.LONG(SD:0x20120088)
&PLL_CLKSW_FDIV6=&PLL_CLKSW_FDIV6|0x0010
D.S SD:0x20120088 %LE %LONG &PLL_CLKSW_FDIV6

&PLL_CLKSW_FDIV6=DATA.LONG(SD:0x20120088)
&PLL_CLKSW_FDIV6=&PLL_CLKSW_FDIV6|0x0400
D.S SD:0x20120088 %LE %LONG &PLL_CLKSW_FDIV6

&PLL_CLKSW_FDIV6=DATA.LONG(SD:0x20120088)
&PLL_CLKSW_FDIV6=&PLL_CLKSW_FDIV6&0xFBFF
D.S SD:0x20120088 %LE %LONG &PLL_CLKSW_FDIV6

&PLL_CLKSW_CKSEL0=DATA.LONG(SD:0x20120060)
&PLL_CLKSW_CKSEL0=&PLL_CLKSW_CKSEL0&0xFF0F
&PLL_CLKSW_CKSEL0=&PLL_CLKSW_CKSEL0|0x0020
D.S SD:0x20120060 %LE %LONG &PLL_CLKSW_CKSEL0

;//Switch MODEMSYS clock to 208MHz from MDPLL
&PLL_CLKSW_FDIV2=DATA.LONG(SD:0x20120078)
&PLL_CLKSW_FDIV2=&PLL_CLKSW_FDIV2&0xFF0F
&PLL_CLKSW_FDIV2=&PLL_CLKSW_FDIV2|0x0020
D.S SD:0x20120078 %LE %LONG &PLL_CLKSW_FDIV2

&PLL_CLKSW_FDIV6=DATA.LONG(SD:0x20120088)
&PLL_CLKSW_FDIV6=&PLL_CLKSW_FDIV6|0x0004
D.S SD:0x20120088 %LE %LONG &PLL_CLKSW_FDIV6

&PLL_CLKSW_FDIV6=DATA.LONG(SD:0x20120088)
&PLL_CLKSW_FDIV6=&PLL_CLKSW_FDIV6|0x0100
D.S SD:0x20120088 %LE %LONG &PLL_CLKSW_FDIV6

&PLL_CLKSW_FDIV6=DATA.LONG(SD:0x20120088)
&PLL_CLKSW_FDIV6=&PLL_CLKSW_FDIV6&0xFEFF
D.S SD:0x20120088 %LE %LONG &PLL_CLKSW_FDIV6

&PLL_CLKSW_CKSEL2=DATA.LONG(SD:0x20120068)
&PLL_CLKSW_CKSEL2=&PLL_CLKSW_CKSEL2&0xF0FF
&PLL_CLKSW_CKSEL2=&PLL_CLKSW_CKSEL2|0x0200
D.S SD:0x20120068 %LE %LONG &PLL_CLKSW_CKSEL2

//Switch WPLL clock to 245.76MHz(WPLL)
&PLL_CLKSW_CKSEL2=DATA.LONG(SD:0x20120068)
&PLL_CLKSW_CKSEL2=&PLL_CLKSW_CKSEL2&0x0FFF
&PLL_CLKSW_CKSEL2=&PLL_CLKSW_CKSEL2|0x2000
D.S SD:0x20120068 %LE %LONG &PLL_CLKSW_CKSEL2

//Switch MCUPLL clock to 250.25MHz(WHPLL)
&PLL_CLKSW_CKSEL2=DATA.LONG(SD:0x20120068)
&PLL_CLKSW_CKSEL2=&PLL_CLKSW_CKSEL2&0xFF0F
&PLL_CLKSW_CKSEL2=&PLL_CLKSW_CKSEL2|0x0040
D.S SD:0x20120068 %LE %LONG &PLL_CLKSW_CKSEL2

// Disable Force on DPM PLL control for PLL
&PLL_DFS_CON7=0x0000
D.S SD:0x201200AC %LE %LONG &PLL_DFS_CON7